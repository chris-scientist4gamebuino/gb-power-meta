// author: chris-scientist
// created at: 17/02/2022
// updated at: 10/03/2022

#include <Gamebuino-Meta.h>

#include "MenuUI.h"

#include "Constants.h"

const bool MenuUI::ITEM_SELECTED            = true;

const bool MenuUI::IS_REVERSE_IMAGE         = true;

const uint8_t MenuUI::NO_ITEM_INDEX         = 0;
const uint8_t MenuUI::PLAY_ITEM_INDEX       = 1;
const uint8_t MenuUI::PLAY_2P_ITEM_INDEX    = 2;
const uint8_t MenuUI::PLAY_1P_ITEM_INDEX    = 3;
const uint8_t MenuUI::SETTINGS_ITEM_INDEX   = 4;
const uint8_t MenuUI::HOME_ITEM_INDEX       = 5;
const uint8_t MenuUI::CREDITS_ITEM_INDEX    = 6;

const int16_t MenuUI::HOME_ICON_INDEX       = 0;
const int16_t MenuUI::PAUSE_ICON_INDEX      = 1;

MenuUI::MenuUI() : 
  currentPageIndex(0),
  iconFrameIndex(MenuUI::HOME_ICON_INDEX)
{
  this->reset();
}

void MenuUI::initialize(uint8_t * anItems, size_t aNbItems, int16_t anIconFrameIndex) {
  this->items = anItems;
  this->nbItems = aNbItems;
  this->iconFrameIndex = anIconFrameIndex;
}

void MenuUI::reset() {
  this->isItemSelectedFlag = ( ! MenuUI::ITEM_SELECTED );
}

void MenuUI::resetCurrentPageIndex() {  this->currentPageIndex = 0; }

void MenuUI::manageCommands() {
  if(gb.buttons.pressed(BUTTON_LEFT)) {
    if(this->currentPageIndex > 0) {
      this->currentPageIndex--;
    }
  } else if(gb.buttons.pressed(BUTTON_RIGHT)) {
    uint8_t nextPageIndex = this->currentPageIndex;
    nextPageIndex++;
    if(nextPageIndex < this->nbItems) {
      this->currentPageIndex = nextPageIndex;
    }
  } else if(gb.buttons.pressed(BUTTON_A)) {
    this->isItemSelectedFlag = MenuUI::ITEM_SELECTED;
  }
}



void MenuUI::rendering() const {
  this->renderingIcon();
  this->renderingItem();
  this->renderingNavigation();
  this->renderingText();
}

const uint8_t MenuUI::getCurrentItemIndex() const {
  uint8_t currentItemIndex = MenuUI::NO_ITEM_INDEX;
  if(this->nbItems > 0) {
    currentItemIndex = this->items[ this->currentPageIndex ];
  }
  return currentItemIndex;
}

void MenuUI::renderingText() const {
  char selectText[] = "Press <A> to select";
  size_t length = sizeof(selectText) / sizeof(*selectText);
  gb.display.setFontSize(1);
  uint8_t w = gb.display.getFontWidth();
  uint8_t h = gb.display.getFontHeight();
  gb.display.setCursor( .5 * ( SCREEN_WIDTH - ( w * length ) ), 5);
  gb.display.setColor(MY_GREY);
  gb.display.print(selectText);
}

void MenuUI::renderingItem() const {
  static const uint8_t MENU_IMAGES[] = {

    // metadata

    78,   // frame width
    78,   // frame height
    0x06, // frames (lower byte)
    0x00, // frames (upper byte)
    0,    // frame loop
    0x0,  // transparent color
    1,    // indexed color mode

    // colormap

    // frame 1/6
    0x00, 0x00, 0x00, 0x00, 0x22, 0x22, 0x22, 0x22, 0x22, 0x22, 0x22, 0x22,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 0x00,
    0x00, 0x00, 0x00, 0x22, 0x22, 0x22, 0x22, 0x22, 0x22, 0x22, 0x22, 0x22,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 0x00,
    0x00, 0x00, 0x22, 0x22, 0x00, 0x00, 0x00, 0x00, 0x00, 0x00, 0x00, 0x00,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 0x00,
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    0x00, 0x00, 0x00, 0x00, 0x22, 0x22, 0x22, 0x22, 0x22, 0x22, 0x22, 0x22,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 0x00,

    // frame 2/6
    0x00, 0x00, 0x00, 0x00, 0x22, 0x22, 0x22, 0x22, 0x22, 0x22, 0x22, 0x22,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 0x00,
    0x00, 0x00, 0x00, 0x22, 0x22, 0x22, 0x22, 0x22, 0x22, 0x22, 0x22, 0x22,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 0x00,
    0x00, 0x00, 0x22, 0x22, 0x00, 0x00, 0x00, 0x00, 0x00, 0x00, 0x00, 0x00,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 0x00,
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    0x00, 0x00, 0x00, 0x00, 0x22, 0x22, 0x22, 0x22, 0x22, 0x22, 0x22, 0x22,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 0x00,

    // frame 3/6
    0x00, 0x00, 0x00, 0x00, 0x22, 0x22, 0x22, 0x22, 0x22, 0x22, 0x22, 0x22,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 0x00,
    0x00, 0x00, 0x00, 0x22, 0x22, 0x22, 0x22, 0x22, 0x22, 0x22, 0x22, 0x22,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 0x00,
    0x00, 0x00, 0x22, 0x22, 0x00, 0x00, 0x00, 0x00, 0x00, 0x00, 0x00, 0x00,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 0x00,
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    0x00, 0x00, 0x00, 0x00, 0x22, 0x22, 0x22, 0x22, 0x22, 0x22, 0x22, 0x22,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 0x00,

    // frame 4/6
    0x00, 0x00, 0x00, 0x00, 0x22, 0x22, 0x22, 0x22, 0x22, 0x22, 0x22, 0x22,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 0x00,
    0x00, 0x00, 0x00, 0x22, 0x22, 0x22, 0x22, 0x22, 0x22, 0x22, 0x22, 0x22,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 0x00,
    0x00, 0x00, 0x22, 0x22, 0x00, 0x00, 0x00, 0x00, 0x00, 0x00, 0x00, 0x00,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 0x00,
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    0x00, 0x00, 0x00, 0x00, 0x22, 0x22, 0x22, 0x22, 0x22, 0x22, 0x22, 0x22,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 0x00,

    // frame 5/6
    0x00, 0x00, 0x00, 0x00, 0x22, 0x22, 0x22, 0x22, 0x22, 0x22, 0x22, 0x22,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 0x00,
    0x00, 0x00, 0x00, 0x22, 0x22, 0x22, 0x22, 0x22, 0x22, 0x22, 0x22, 0x22,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 0x00,
    0x00, 0x00, 0x22, 0x22, 0x00, 0x00, 0x00, 0x00, 0x00, 0x00, 0x00, 0x00,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 0x00,
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    0x00, 0x00, 0x00, 0x00, 0x22, 0x22, 0x22, 0x22, 0x22, 0x22, 0x22, 0x22,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 0x00,

    // frame 6/6
    0x00, 0x00, 0x00, 0x00, 0x22, 0x22, 0x22, 0x22, 0x22, 0x22, 0x22, 0x22,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 0x00,
    0x00, 0x00, 0x00, 0x22, 0x22, 0x22, 0x22, 0x22, 0x22, 0x22, 0x22, 0x22,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 0x00,
    0x00, 0x00, 0x22, 0x22, 0x00, 0x00, 0x00, 0x00, 0x00, 0x00, 0x00, 0x00,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 0x00,
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    0x00, 0x00, 0x00, 0x00, 0x22, 0x22, 0x22, 0x22, 0x22, 0x22, 0x22, 0x22,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 0x00

  };

  int16_t item = 0;
  if(this->isCurrentChoicePlayTwoPlayerItem()) {        item = 1; } 
  else if(this->isCurrentChoicePlayOnePlayerItem()) {   item = 2; }
  else if(this->isCurrentChoiceSettingsItem()) {        item = 3; }
  else if(this->isCurrentChoiceHomeItem()) {            item = 4; }
  else if(this->isCurrentChoiceCreditsItem()) {         item = 5; }

  Image menuImg(MENU_IMAGES);
  menuImg.setFrame(item);

  int16_t itemSize = 78; // height and width
  gb.display.drawImage(
    .5 * (SCREEN_WIDTH - itemSize),     // x-pos
    .5 * (SCREEN_HEIGHT - itemSize),    // y-pos
    menuImg,                            // image
    itemSize,                           // width
    itemSize                            // height
  );
}

void MenuUI::renderingIcon() const {
  static const uint8_t ICON_IMAGES[] = {

    // metadata

    16,   // frame width
    16,   // frame height
    0x02, // frames (lower byte)
    0x00, // frames (upper byte)
    0,    // frame loop
    0x0,  // transparent color
    1,    // indexed color mode

    // colormap

    // frame 1/2
    0x00, 0x00, 0x00, 0x00, 0x00, 0x00, 0x00, 0x00,
    0x00, 0x00, 0x00, 0x44, 0x44, 0x00, 0x00, 0x00,
    0x00, 0x00, 0x04, 0x00, 0x00, 0x40, 0x00, 0x00,
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    0x00, 0x04, 0x44, 0x44, 0x44, 0x44, 0x40, 0x00,

    // frame 2/2
    0x00, 0x00, 0x00, 0x00, 0x00, 0x00, 0x00, 0x00,
    0x00, 0x04, 0x44, 0x40, 0x04, 0x44, 0x40, 0x00,
    0x00, 0x04, 0x44, 0x40, 0x04, 0x44, 0x40, 0x00,
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    0x00, 0x00, 0x00, 0x00, 0x00, 0x00, 0x00, 0x00

  };

  Image iconImg(ICON_IMAGES);
  iconImg.setFrame(this->iconFrameIndex);

  int16_t iconSize = 16; // height and width
  int16_t offset = 5;
  int16_t padding = 2;
  int16_t xPositionBackground = offset;
  int16_t yPositionBackground = 0;
  int16_t widthBackground = ( iconSize + ( 2 * padding ) );
  int16_t heightBackground = ( iconSize + ( 2 * offset ) );

  // Draw background of icon
  gb.display.setColor(MY_GREY);
  gb.display.fillRect(
    xPositionBackground,
    yPositionBackground,
    widthBackground,
    heightBackground
  );

  int16_t xPosition = offset + padding;
  int16_t yPosition = offset;

  // Draw icon
  gb.display.drawImage(
    xPosition,  // x-pos
    yPosition,  // y-pos
    iconImg,    // image
    iconSize,   // width
    iconSize    // height
  );
}

const int16_t MenuUI::computePositionForNavigationItem(const uint8_t itPage, const bool isReverseImageFlag) const {
  int16_t xMarginItem = 1;
  if( isReverseImageFlag == MenuUI::IS_REVERSE_IMAGE) {
    xMarginItem = 2;
  }
  const int16_t X_OFFSET_ITEM = 6 + xMarginItem;
  const int16_t SIZE_ITEM = (6 + 2);
  const int16_t WIDTH_BAR = ( this->nbItems * SIZE_ITEM );
  const int16_t X_RELATIVE_POSITION = ( .5 * (SCREEN_WIDTH - WIDTH_BAR) );
  int16_t xTotalOffset = 0;
  if(itPage > 0) {
    xTotalOffset = ( SIZE_ITEM * ( itPage - 1 ) + X_OFFSET_ITEM );
  }
  return ( X_RELATIVE_POSITION + xTotalOffset );
}

void MenuUI::renderingNavigation() const {
  const uint8_t LEFT_ARROW_FRAME_INDEX        = 0;
  const uint8_t OTHER_POSITION_FRAME_INDEX    = 1;
  const uint8_t CURRENT_POSITION_FRAME_INDEX  = 2;

  for(uint8_t itPage = 0 ; itPage < this->nbItems ; itPage++) {
    bool isReverseImageFlag = ( ! MenuUI::IS_REVERSE_IMAGE );
    uint8_t frameIndex = CURRENT_POSITION_FRAME_INDEX;
    if(itPage != this->currentPageIndex) {
      if(itPage == 0) {
        // Left arrow
        frameIndex = LEFT_ARROW_FRAME_INDEX;
      } else if(itPage == (this->nbItems - 1)) {
        // Right arrow
        frameIndex = LEFT_ARROW_FRAME_INDEX;
        isReverseImageFlag = MenuUI::IS_REVERSE_IMAGE;
      } else {
        // Other position
        frameIndex = OTHER_POSITION_FRAME_INDEX;
      }
    }
    //
    // Compute xPosition
    const int16_t xPosition = this->computePositionForNavigationItem(itPage, isReverseImageFlag);
    //
    // Current rendering item
    this->renderingUnitNavigation(frameIndex, isReverseImageFlag, xPosition);
  }
}

void MenuUI::renderingUnitNavigation(const uint8_t aFrameIndex, const bool isReverseImageFlag, const int16_t xPosition) const {
  static const uint8_t NAVIGATION_IMAGES[] = {

      // metadata

      6,    // frame width
      6,    // frame height
      0x03, // frames (lower byte)
      0x00, // frames (upper byte)
      0,    // frame loop
      0x0,  // transparent color
      1,    // indexed color mode

      // colormap

      // frame 1/3
      0x00, 0x00, 0x22,
      0x00, 0x22, 0x22,
      0x02, 0x22, 0x22,
      0x00, 0x22, 0x22,
      0x00, 0x00, 0x22,
      0x00, 0x00, 0x00,

      // frame 2/3
      0x00, 0x22, 0x20,
      0x02, 0x22, 0x22,
      0x02, 0x22, 0x22,
      0x02, 0x22, 0x22,
      0x00, 0x22, 0x20,
      0x00, 0x00, 0x00,

      // frame 3/3
      0x00, 0x22, 0x20,
      0x02, 0x20, 0x22,
      0x02, 0x00, 0x02,
      0x02, 0x20, 0x22,
      0x00, 0x22, 0x20,
      0x00, 0x00, 0x00

  };

  Image navigationImg(NAVIGATION_IMAGES);
  navigationImg.setFrame(aFrameIndex);

  int16_t itemSize = 6; // height and width
  int16_t reverseFactor = ( (isReverseImageFlag == MenuUI::IS_REVERSE_IMAGE) ? -1 : 1 );
  gb.display.drawImage(
    xPosition,                          // x-pos
    (SCREEN_HEIGHT - (itemSize * 2) ),  // y-pos
    navigationImg,                      // image
    reverseFactor * itemSize,           // width
    itemSize                            // height
  );
}

const bool MenuUI::isItemSelected() const {   return (this->isItemSelectedFlag == MenuUI::ITEM_SELECTED); }

const bool MenuUI::isCurrentChoicePlayItem() const {            return ( this->getCurrentItemIndex() == MenuUI::PLAY_ITEM_INDEX ); }
const bool MenuUI::isCurrentChoicePlayTwoPlayerItem() const {   return ( this->getCurrentItemIndex() == MenuUI::PLAY_2P_ITEM_INDEX ); }
const bool MenuUI::isCurrentChoicePlayOnePlayerItem() const {   return ( this->getCurrentItemIndex() == MenuUI::PLAY_1P_ITEM_INDEX ); }
const bool MenuUI::isCurrentChoiceSettingsItem() const {        return ( this->getCurrentItemIndex() == MenuUI::SETTINGS_ITEM_INDEX ); }
const bool MenuUI::isCurrentChoiceHomeItem() const {            return ( this->getCurrentItemIndex() == MenuUI::HOME_ITEM_INDEX ); }
const bool MenuUI::isCurrentChoiceCreditsItem() const {         return ( this->getCurrentItemIndex() == MenuUI::CREDITS_ITEM_INDEX ); }

const bool MenuUI::isPlayItem() const {             return ( this->isItemSelected() && this->isCurrentChoicePlayItem() ); }
const bool MenuUI::isPlayTwoPlayerItem() const {    return ( this->isItemSelected() && this->isCurrentChoicePlayTwoPlayerItem() ); }
const bool MenuUI::isPlayOnePlayerItem() const {    return ( this->isItemSelected() && this->isCurrentChoicePlayOnePlayerItem() ); }
const bool MenuUI::isSettingsItem() const {         return ( this->isItemSelected() && this->isCurrentChoiceSettingsItem() ); }
const bool MenuUI::isHomeItem() const {             return ( this->isItemSelected() && this->isCurrentChoiceHomeItem() ); }
const bool MenuUI::isCreditsItem() const {          return ( this->isItemSelected() && this->isCurrentChoiceCreditsItem() ); }
